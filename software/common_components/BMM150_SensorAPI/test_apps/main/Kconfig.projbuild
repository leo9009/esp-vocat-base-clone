## software/common_components/BMM150_SensorAPI/test_apps/main/Kconfig.projbuild
```kconfig
menu "Example Configuration"

    config I2C_MASTER_SCL_IO
        int "SCL GPIO Num"
        default 0
        help
            GPIO number for I2C Master clock line.

    config I2C_MASTER_SDA_IO
        int "SDA GPIO Num"
        default 45
        help
            GPIO number for I2C Master data line.

    config I2C_INT_IO
        int "INT GPIO Num"
        default 16
        help
            GPIO number for sensor interrupt line.

endmenu
```

## software/vocat_rotating_base/components/magnetic_slide_switch/Kconfig
```kconfig
menu "Magnetic Slide Switch Sensor Selection"

choice
    prompt "Select sensor type"
    default SENSOR_MAGNETOMETER
    help
        Choose the type of sensor for magnetic slide switch detection.

    config SENSOR_LINEAR_HALL
        bool "Linear Hall Sensor"
        help
            Use linear hall sensor for magnetic field detection.
            This sensor provides analog output proportional to magnetic field strength.

    config SENSOR_MAGNETOMETER
        bool "Magnetometer Sensor"
        help
            Use digital magnetometer sensor for magnetic field detection.
            Provides more precise magnetic field measurements with digital interface.

endchoice

choice
    prompt "Select magnetometer type"
    default SENSOR_BMM150
    depends on SENSOR_MAGNETOMETER
    help
        Choose the specific magnetometer sensor model when magnetometer is selected.

    config SENSOR_BMM150
        bool "BMM150 Magnetometer"
        help
            Bosch BMM150 3-axis magnetometer sensor with I2C interface.

    config SENSOR_QMC6309
        bool "QMC6309 Magnetometer" 
        help
            QST QMC6309 3-axis magnetometer sensor with I2C interface.

endchoice

endmenu
```
